VERSION ""

NS_ :

BS_:

BU_: Master Drive

BO_ 512 RPDO1_TargetTorque: 8 Master
 SG_ TargetTorque : 0|16@1- (1,0) [-32768|32767] "raw" Drive

BO_ 384 TPDO1_PositionVelocity: 8 Drive
 SG_ ActualPosition : 0|32@1- (1,0) [-2147483648|2147483647] "counts" Master
 SG_ ActualVelocity : 32|16@1- (1,0) [-32768|32767] "raw" Master

BO_ 640 TPDO2_StatusTorque: 8 Drive
 SG_ StatusWord : 0|16@1+ (1,0) [0|65535] "" Master
 SG_ ActualTorque : 16|16@1- (1,0) [-32768|32767] "raw" Master

CM_ "Generic CANopen DS402 PDO definitions for virtual_servo_driver.";
CM_ SG_ 512 TargetTorque "0x6071: Target Torque";
CM_ SG_ 384 ActualPosition "0x6064: Position Actual Value";
CM_ SG_ 384 ActualVelocity "0x606C: Velocity Actual Value";
CM_ SG_ 640 StatusWord "0x6041: Statusword";
CM_ SG_ 640 ActualTorque "0x6077: Torque Actual Value";
